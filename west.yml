## west.yml
```yaml
manifest:
  defaults:
    remote: upstream

  remotes:
    - name: upstream
      url-base: https://github.com/egevirgen

  #
  # Please add items below based on alphabetical order
  projects:
    - name: app
      revision: MIMXRT1170-EVK
      path: Compile/app
    - name: mcrt
      revision: mcrt_rt1170
      path: Compile/mcrt
    - name: CANopenNode
      revision: master
      path: Compile/mcrt/communication/canopen/canopennode
    - name: driver
      revision : MIMXRT1170-EVK
      path : Compile/mcrt/communication/canopen/driver
    - name: od
      revision : example_od
      path : Compile/mcrt/communication/canopen/od
    - name: toolchain
      revision : MIMXRT1170-EVK
      path : Compile/toolchain

  self:
    path: Compile
    west-commands: scripts/west-commands.yml
```
